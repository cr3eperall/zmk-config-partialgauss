## config/boards/shields/corne1/Kconfig.shield
```kconfig
# Copyright (c) 2020 Pete Johanson
# SPDX-License-Identifier: MIT

config SHIELD_CORNE1_LEFT
    def_bool $(shields_list_contains,corne1_left)

config SHIELD_CORNE1_RIGHT
    def_bool $(shields_list_contains,corne1_right)
```

## config/boards/shields/partial_gauss/Kconfig.shield
```kconfig
# Copyright (c) 2025 cr3eperal
# SPDX-License-Identifier: MIT

config SHIELD_PARTIAL_GAUSS_LEFT
    def_bool $(shields_list_contains,partial_gauss_left)

config SHIELD_PARTIAL_GAUSS_RIGHT
    def_bool $(shields_list_contains,partial_gauss_right)
```

## config/west.yml
```yaml
manifest:
  remotes:
    - name: zmkfirmware
      url-base: https://github.com/zmkfirmware
    - name: cr3eperall
      url-base: https://github.com/cr3eperall
    # Additional modules containing boards/shields/custom code can be listed here as well
    # See https://docs.zephyrproject.org/3.2.0/develop/west/manifest.html#projects
  projects:
    - name: zmk
      remote: cr3eperall
      revision: fix-child-node-dependencies
      import: app/west.yml
    - name: zmk-feature-hall-effect
      remote: cr3eperall
      revision: main
    - name: zmk-nano33ble-board
      remote: cr3eperall
      revision: main
  self:
    path: config
```
